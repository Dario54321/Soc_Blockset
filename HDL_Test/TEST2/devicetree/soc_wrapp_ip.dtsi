
&fpga_axi {
	// Device tree node for Mathworks-generated IP core "soc_wrapp_ip"
	mwipcore0: mwipcore@400D0000 {
		reg = <0x400D0000 0x10000>;
	};
};

&mwipcore0 {
	compatible = "mathworks,mwipcore-v3.00";
	#address-cells = <0x1>;
	#size-cells = <0x0>;
	// Device tree node for read channel of interface "AXI4-Lite"
	mmrd-channel@0 {
		reg = <0x0>;
		compatible = "mathworks,mm-read-channel-v1.00";
		mathworks,dev-name = "mmrd0";
	};
	// Device tree node for write channel of interface "AXI4-Lite"
	mmwr-channel@1 {
		reg = <0x1>;
		compatible = "mathworks,mm-write-channel-v1.00";
		mathworks,dev-name = "mmwr0";
	};
};

